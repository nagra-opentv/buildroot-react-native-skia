## Config.in
```kconfig
# Include all package configuration snippets from the overlay.
source "$BR2_EXTERNAL_RNS_PATH/package/chromium_depot_tools/Config.in"
source "$BR2_EXTERNAL_RNS_PATH/package/eglinfo/Config.in"
source "$BR2_EXTERNAL_RNS_PATH/package/javascriptcore/Config.in"
source "$BR2_EXTERNAL_RNS_PATH/package/nopoll/Config.in"
source "$BR2_EXTERNAL_RNS_PATH/package/react-native-skia/Config.in"
source "$BR2_EXTERNAL_RNS_PATH/package/react-native-skia-samples/Config.in"
source "$BR2_EXTERNAL_RNS_PATH/package/wpebackend-rdk/Config.in"
```

## configs/raspberrypi3_rns_vc4_wayland_defconfig
```kconfig
BR2_arm=y
BR2_cortex_a53=y
BR2_ARM_FPU_NEON_VFPV4=y
BR2_CCACHE=y
BR2_CCACHE_DIR="$(TOPDIR)/ccache/buildroot-ccache-$(BR2_ARCH)"
BR2_GLOBAL_PATCH_DIR="$(BR2_EXTERNAL_RNS_PATH)/patches $(BR2_EXTERNAL_RNS_PATH)/board/raspberrypi3/patches"
BR2_DL_DIR="/opt/workshop/external/foss_dl"

BR2_TOOLCHAIN_BUILDROOT_CXX=y
BR2_TOOLCHAIN_BUILDROOT_GLIBC=y
BR2_TOOLCHAIN_EXTERNAL=y
BR2_TOOLCHAIN_EXTERNAL_DOWNLOAD=y
BR2_TOOLCHAIN_EXTERNAL_ARM_ARM=y

BR2_SYSTEM_DHCP="eth0"

# Linux headers same as kernel, a 5.10 series
BR2_PACKAGE_HOST_LINUX_HEADERS_CUSTOM_5_10=y

BR2_LINUX_KERNEL=y
BR2_LINUX_KERNEL_CUSTOM_TARBALL=y
BR2_LINUX_KERNEL_CUSTOM_TARBALL_LOCATION="$(call github,raspberrypi,linux,967d45b29ca2902f031b867809d72e3b3d623e7a)/linux-967d45b29ca2902f031b867809d72e3b3d623e7a.tar.gz"
BR2_LINUX_KERNEL_DEFCONFIG="bcm2709"

# Build the DTB from the kernel sources
BR2_LINUX_KERNEL_DTS_SUPPORT=y
BR2_LINUX_KERNEL_INTREE_DTS_NAME="bcm2710-rpi-3-b bcm2710-rpi-3-b-plus bcm2710-rpi-cm3"

BR2_LINUX_KERNEL_NEEDS_HOST_OPENSSL=y

# Debugging
BR2_PACKAGE_GDB=y
BR2_PACKAGE_GDB_SERVER=y
BR2_PACKAGE_GDB_DEBUGGER=y
BR2_PACKAGE_GDB_TUI=y
BR2_PACKAGE_STRACE=y
BR2_PACKAGE_BITSTREAM_VERA=y

# MESA3D VC4
BR2_PACKAGE_MESA3D=y
BR2_PACKAGE_MESA3D_GALLIUM_DRIVER_V3D=y
BR2_PACKAGE_MESA3D_GALLIUM_DRIVER_VC4=y
BR2_PACKAGE_MESA3D_OPENGL_ES=y

# Wayland compositors
BR2_PACKAGE_WESTON=y
BR2_PACKAGE_WESTON_DEFAULT_DRM=y

# RPI Firmware and driver
BR2_PACKAGE_RPI_FIRMWARE=y
BR2_PACKAGE_RPI_FIRMWARE_BOOTCODE_BIN=y
BR2_PACKAGE_RPI_FIRMWARE_VARIANT_PI=y
BR2_PACKAGE_RPI_FIRMWARE_CONFIG_FILE="board/raspberrypi3/config_3.txt"

# Networking
BR2_PACKAGE_DROPBEAR=y
BR2_PACKAGE_NTP=y
BR2_PACKAGE_NTP_NTPDATE=y

# Required tools to create the SD image
BR2_PACKAGE_HOST_DOSFSTOOLS=y
BR2_PACKAGE_HOST_GENIMAGE=y
BR2_PACKAGE_HOST_MTOOLS=y

# Filesystem / image
BR2_TARGET_ROOTFS_EXT2=y
BR2_TARGET_ROOTFS_EXT2_4=y
BR2_TARGET_ROOTFS_EXT2_SIZE="384M"
BR2_TARGET_GENERIC_ROOT_PASSWD="root"
BR2_ROOTFS_DEVICE_CREATION_DYNAMIC_EUDEV=y
# BR2_TARGET_ROOTFS_TAR is not set
BR2_ROOTFS_POST_BUILD_SCRIPT="$(BR2_EXTERNAL_RNS_PATH)/board/raspberrypi3/post-build.sh"
BR2_ROOTFS_POST_IMAGE_SCRIPT="$(BR2_EXTERNAL_RNS_PATH)/board/raspberrypi3/post-image.sh"
BR2_ROOTFS_POST_SCRIPT_ARGS="--add-miniuart-bt-overlay --add-vc4-fkms-v3d-overlay --gpu_mem_1024=300"

# Rns and dep packages
BR2_PACKAGE_EGLINFO=y
BR2_PACKAGE_WPEBACKEND_RDK=y
BR2_PACKAGE_WPEWEBKIT=y
BR2_PACKAGE_WPEWEBKIT_BUILD_JSC=y
BR2_PACKAGE_WPEWEBKIT_MINIBROWSER=y
BR2_PACKAGE_REACT_NATIVE_SKIA=y
BR2_PACKAGE_REACT_NATIVE_SKIA_SAMPLES=y
```

## package/chromium_depot_tools/Config.in
```kconfig
config BR2_PACKAGE_CHROMIUM_DEPOT_TOOLS
	bool "Chromium Depot Tools"
	help
	  Provides chromium depot tools
```

## package/gst-plugins-rs/Config.in
```kconfig
config BR2_PACKAGE_GST_PLUGINS_RS
     bool "Gst-Plugins-Rs"
     depends on BR2_PACKAGE_HOST_RUSTC_TARGET_ARCH_SUPPORTS
     select BR2_PACKAGE_HOST_RUSTC
     select BR2_PACKAGE_GSTREAMER1
     select BR2_PACKAGE_GST1_PLUGINS_GOOD
     help
       This is a comment that explains what foo is.

       https://gitlab.freedesktop.org/gstreamer/gst-plugins-rs
```

## package/javascriptcore/Config.in
```kconfig
config BR2_PACKAGE_JAVASCRIPTCORE_WPE
	bool "Javascriptcore WPE"
	select BR2_PACKAGE_HAS_LIBEGL_WAYLAND
	help
	  A workaround to build WPE in JSC only mode when we are not building WPE webkit with wayland
```

## package/nopoll/Config.in
```kconfig
config BR2_PACKAGE_NOPOLL
	bool "nopoll"
	select BR2_PACKAGE_OPENSSL
	help
	    noPoll is a OpenSource WebSocket implementation (RFC 6455), written in ansi C,
            that allows building pure WebSocket solutions or to provide WebSocket support
            to existing TCP oriented applications
```

## package/react-native-skia-samples/Config.in
```kconfig
config BR2_PACKAGE_REACT_NATIVE_SKIA_SAMPLES
	bool "Sample App Bundles"
	default y
	depends on BR2_PACKAGE_REACT_NATIVE_SKIA
	help
	  React Native
	  https://reactnative.dev/
```

## package/react-native-skia/Config.in
```kconfig
config BR2_PACKAGE_REACT_NATIVE_SKIA
	bool "React Native Skia"
	depends on BR2_PACKAGE_WPEWEBKIT
	select BR2_PACKAGE_BOOST
	select BR2_PACKAGE_CHROMIUM_DEPOT_TOOLS
	select BR2_PACKAGE_NOPOLL
	select BR2_PACKAGE_EXPAT
	select BR2_PACKAGE_FREETYPE
	select BR2_PACKAGE_HARFBUZZ
	select BR2_PACKAGE_ICU
	select BR2_PACKAGE_JPEG_TURBO
	select BR2_PACKAGE_LIBCURL
	select BR2_PACKAGE_LIBPNG
	select BR2_PACKAGE_LIBWPE
	select BR2_PACKAGE_WEBP
	select BR2_PACKAGE_WEBP_DEMUX
	select BR2_PACKAGE_WEBP_MUX
	select BR2_PACKAGE_WPEBACKEND_RDK
	help
	  React Native
	  https://reactnative.dev/

config BR2_PACKAGE_RNS_APPS_DIR
  string "Application and its configuration directory path"
  depends on BR2_PACKAGE_REACT_NATIVE_SKIA
  help
    Specify the DIR path where RNS application and
    RSkCodegenConf.json are present
```
